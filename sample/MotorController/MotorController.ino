// macMoober
// Crop: 0 to 70489 ms; tempo x1.
// Transpose -14; octave fit 43..62: true.
// Fixed mapping: note 55 = 50 us HIGH / 50 us LOW.
// Waits for the OLED controller start signal, then plays once. Reset both boards to replay.
// One A4988 per motor; each motor needs its OWN STEP/DIR wires.
#include <Arduino.h>

const uint8_t START_SYNC_PIN = 15;

struct Segment { uint32_t endMs; uint32_t halfPeriodUs; };
// Motor 1: Clean Guitar  ch 1
const Segment part1[] = {
  {210UL, 89UL},
  {420UL, 67UL},
  {629UL, 50UL},
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  {70489UL, 56UL}
};

// Motor 2: Grand Piano Classic  ch 2
const Segment part2[] = {
  {2937UL, 67UL},
  {3357UL, 75UL},
  {5874UL, 84UL},
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  {70489UL, 56UL}
};

struct Motor {
  uint8_t stepPin;
  uint8_t dirPin;
  const Segment* part;
  size_t count;
  size_t index;
  uint32_t halfPeriodUs;
  uint32_t lastEdgeUs;
  bool high;
};

Motor motors[] = {
  {16, 17, part1, sizeof(part1) / sizeof(part1[0]), 0, 0, 0, false},
  {19, 18, part2, sizeof(part2) / sizeof(part2[0]), 0, 0, 0, false}
};
const size_t MOTOR_COUNT = sizeof(motors) / sizeof(motors[0]);
const uint32_t SONG_DURATION_MS = 70489UL;
uint32_t songStartMs = 0;
bool playing = false;

void setup() {
  for (size_t i = 0; i < MOTOR_COUNT; ++i) {
    Motor& m = motors[i];
    pinMode(m.stepPin, OUTPUT);
    pinMode(m.dirPin, OUTPUT);
    digitalWrite(m.stepPin, LOW);
    digitalWrite(m.dirPin, LOW);
    m.halfPeriodUs = m.part[0].halfPeriodUs;
  }
  pinMode(START_SYNC_PIN, INPUT_PULLDOWN);
  while (digitalRead(START_SYNC_PIN) == LOW) delay(1);

  songStartMs = millis();
  uint32_t startUs = micros();
  for (size_t i = 0; i < MOTOR_COUNT; ++i) motors[i].lastEdgeUs = startUs;
  playing = true;
}

void loop() {
  if (!playing) { delay(10); return; }
  const uint32_t elapsedMs = millis() - songStartMs;
  if (elapsedMs >= SONG_DURATION_MS) {
    for (size_t i = 0; i < MOTOR_COUNT; ++i) {
      digitalWrite(motors[i].stepPin, LOW);
      motors[i].high = false;
    }
    playing = false;
    return;
  }
  for (size_t i = 0; i < MOTOR_COUNT; ++i) {
    Motor& m = motors[i];
    while (m.index < m.count && elapsedMs >= m.part[m.index].endMs) ++m.index;
    const uint32_t period = m.index < m.count ? m.part[m.index].halfPeriodUs : 0;
    uint32_t nowUs = micros();
    if (period != m.halfPeriodUs) {
      digitalWrite(m.stepPin, LOW);
      m.high = false;
      m.halfPeriodUs = period;
      m.lastEdgeUs = nowUs;
    }
    if (period && nowUs - m.lastEdgeUs >= period) {
      m.high = !m.high;
      digitalWrite(m.stepPin, m.high ? HIGH : LOW);
      m.lastEdgeUs = nowUs;
    }
  }
}
